## firmware/esp32-csi-receiver/main/Kconfig.projbuild
```kconfig
menu "SenseBeyond CSI Receiver"

config SENSEBEYOND_WIFI_SSID
    string "Wi-Fi SSID"
    default "SenseBeyond-CSI"
    help
        SSID of the network the receiver joins.

config SENSEBEYOND_WIFI_PASSWORD
    string "Wi-Fi Password"
    default "sensebeyond"
    help
        WPA2 password. Leave empty for open networks.

config SENSEBEYOND_BACKEND_URL
    string "Backend Base URL"
    default "http://192.168.1.100:8000"
    help
        Base URL for the SenseBeyond FastAPI backend (no trailing slash).

config SENSEBEYOND_DEVICE_LABEL
    string "Device Identifier"
    default "esp32-receiver"
    help
        Identifier reported as the MAC label in CSI payloads. Use the board MAC for uniqueness.

config SENSEBEYOND_POST_INTERVAL_MS
    int "CSI Post Interval (ms)"
    range 50 1000
    default 200
    help
        Time window for batching CSI frames before posting to the backend.

config SENSEBEYOND_HTTP_RETRY_MS
    int "HTTP Retry Backoff (ms)"
    range 200 10000
    default 500
    help
        Delay before retrying failed HTTP posts.

config SENSEBEYOND_MAX_QUEUE_DEPTH
    int "CSI Queue Depth"
    range 4 64
    default 16
    help
        Maximum number of CSI frames buffered while awaiting transmission.

endmenu
```

## firmware/esp32-csi-receiver/sdkconfig.defaults
```kconfig
CONFIG_ESP_WIFI_CSI_ENABLED=y
CONFIG_ESP32_WIFI_CSI_ENABLED=y
CONFIG_SENSEBEYOND_BACKEND_URL=""
```

## firmware/esp32-csi-sender/main/Kconfig.projbuild
```kconfig
menu "SenseBeyond CSI Sender"

config SENSEBEYOND_SENDER_SSID
    string "SoftAP SSID"
    default "SenseBeyond-CSI"
    help
        SSID broadcast by the sender board. Configure the receiver to join this network.

config SENSEBEYOND_SENDER_PASSWORD
    string "SoftAP Password"
    default "sensebeyond"
    help
        WPA2 password for the SoftAP. Leave empty for an open network.

config SENSEBEYOND_SENDER_CHANNEL
    int "SoftAP Channel"
    range 1 13
    default 6
    help
        2.4 GHz channel number. Ensure the receiver and environment use the same channel.

config SENSEBEYOND_TARGET_MAC
    string "Target Receiver MAC"
    default "24:0A:C4:12:34:56"
    help
        Destination MAC address for generated frames (format: aa:bb:cc:dd:ee:ff).

config SENSEBEYOND_TX_INTERVAL_MS
    int "Frame TX Interval (ms)"
    range 5 1000
    default 20
    help
        Period between injected null-data frames. Lower values increase CSI throughput at the cost of airtime.

endmenu
```
